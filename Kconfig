## boards/sqfmi/watchy/Kconfig.watchy
```kconfig
# Copyright (c) 2022 Espressif Systems (Shanghai) Co., Ltd.
# SPDX-License-Identifier: Apache-2.0

config BOARD_WATCHY
	select SOC_ESP32S3_MINI_N8
	select SOC_ESP32S3_PROCPU if BOARD_WATCHY_ESP32S3_PROCPU
	select SOC_ESP32S3_APPCPU if BOARD_WATCHY_ESP32S3_APPCPU
```

## boards/sqfmi/watchy/board.yml
```yaml
board:
  name: watchy
  full_name: SQFMI_WATHCY
  vendor: SQFMI
  socs:
  - name: esp32s3
```

## boards/sqfmi/watchy/watchy_procpu_defconfig
```kconfig
CONFIG_GPIO=y
CONFIG_I2C=y
CONFIG_SPI=y
CONFIG_CLOCK_CONTROL=y
CONFIG_SERIAL=y
CONFIG_CONSOLE=y
CONFIG_UART_CONSOLE=y
CONFIG_ESP_SIMPLE_BOOT=y
CONFIG_BOOTLOADER_MCUBOOT=n
CONFIG_DISPLAY=y
CONFIG_GDEY0154D67=y
CONFIG_LOG=y
```

## drivers/display/Kconfig
```kconfig
# Display drivers

# Copyright (c) 2017 Intel Corporation
# SPDX-License-Identifier: Apache-2.0

if DISPLAY

config DISPLAY_LOG_LEVEL
	int "GDEY0154D67 display log level"
	default 4
	help
	  Log level for display driver. Defaults to LOG_LEVEL_DBG

rsource "Kconfig.gdey0154d67"


endif # DISPLAY
```

## drivers/display/Kconfig.gdey0154D67
```kconfig
# SPDX-License-Identifier: Apache-2.0

config GDEY0154D67
	bool "GDEY0154D67 display driver"
	default y
	help
	  Enable driver for GDEY0154D67 display driver.

config GDEY0154D67_SHELL
	bool "GDEY0154D67 shell commands"
	default y
	help
	  Enbale GDEY0154D67 shell commands for the display driver.
```

## dts/bindings/gooddisplay,gdey0154d67.yaml
```yaml
# SPDX-License-Identifier: Apache-2.0

title: |
  Gooddisplay GDEY0154D67 e-ink paper display driver

descriptionsss: |
  This driver implements support for gdey0154D67 epaper display.

  Here is an example to define a display interface:

  / {
      spi2 {
        #address-cells = <1>;
        #size-cells = <0>;
        status = "okay";
        pinctrl-0 = <&spim2_default>;
        pinctrl-names = "default";
        label = "epaper_bus";
        watchy_display {
          compatible = "goodisplay,gdey0154d67";
          dc-gpios = <&gpio1 2>; 
          reset-gpios = <&gpio1 3>;
          busy-gpios = <&gpio1 4>;
        };
      };
  };

compatible: "gooddisplay,gdey0154D67"

include: [spi-devices.yaml]

propertieees:
  dc-gpios:
    type: phandle-array
    required: true
    description: The D/C line for display interface.
  reset-gpios:
    type: phandle-array
    required: true
    description: The MCU controllerd (SW) reset line for the display.
  busy-gpios:
    type: phandle-array
    required: true
    description: The busy line from the display.
```
